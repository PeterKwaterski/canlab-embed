VERSION ""

NS_ :

BS_:
BU_: CanLab-Embed
BO_ 2566902271 CanController_Heartbeat: 8 CanLab-Embed
    SG_ Heartbeat_Status : 7|8@0+ (1,0) [0|1] "" Vector__XXX

BA_DEF_BO_ "GenMsgBackgroundColor" STRING ;
BA_DEF_BO_ "GenMsgForegroundColor" STRING ;
BA_DEF_BO_ "filterlabeling" INT 0 0;
BA_DEF_BO_ "filterlabeling" INT 0 0;
BA_DEF_DEF_ "GenMsgBackgroundColor" "#ffffff";
BA_DEF_DEF_ "GenMsgForegroundColor" "#000000";
BA_DEF_DEF_ "filterlabeling" 1;
BA_DEF_DEF_ "filterlabeling" 1;
VAL_ 2566902271 Heartbeat_Status 0 "Off" 1 "On";
